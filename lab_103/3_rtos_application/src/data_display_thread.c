/*
 * data_display_thread.c
 *
 * this is a thread that pulls the data generated by another thread from a
 * mail queue and then displays it in a terminal
 *
 * author:    Dr. Alex Shenfield
 * date:      06/09/2018
 * purpose:   55-604481 embedded computer networks : lab 103
 */

// include cmsis_os for the rtos api and the stdio package for printing
#include "cmsis_os.h"
#include <stdio.h>

// include main.h (this is where we initialise the mail type)
#include "main.h"

// include the shu bsp libraries for the stm32f7 discovery board and the serial
// configuration files
#include "pinmappings.h"
#include "clock.h"
#include "serial.h"
#include "stm32746g_discovery_lcd.h"

// RTOS DEFINES

// declare the thread function prototypes, thread id, and priority
void display_thread(void const *argument);
osThreadId tid_display_thread;
osThreadDef(display_thread, osPriorityNormal, 1, 0);

// the mailbox we are pulling data from is declared elsewhere ...
extern osMailQId mail_box_2;

// THREAD INITIALISATION

// create the data display thread
int init_display_thread(void)
{
	// initialise the lcd
  BSP_LCD_Init();
  BSP_LCD_LayerDefaultInit(LTDC_ACTIVE_LAYER, SDRAM_DEVICE_ADDR);
  BSP_LCD_SelectLayer(LTDC_ACTIVE_LAYER);
	
	// set the background colour to blue and clear the lcd
  BSP_LCD_SetBackColor(LCD_COLOR_BLUE);
  BSP_LCD_Clear(LCD_COLOR_BLUE);
	BSP_LCD_SetTextColor(LCD_COLOR_WHITE);
  
  // set the font to use
  BSP_LCD_SetFont(&Font24); 
	
  // initialize peripherals (i.e. the uart) here
  init_uart(9600);
  printf("display thread up and running ...\r\n");

  // create the thread and get its task id
  tid_display_thread = osThreadCreate(osThread(display_thread), NULL);

  // check if everything worked ...
  if(!tid_display_thread)
  {
    return(-1);
  }
  return(0);
}

// ACTUAL THREADS

// data display thread - pull the data out of the mail queue and print it to
// the uart
void display_thread(void const *argument)
{
  while(1)
  {
		// get the data ...
    osEvent evt = osMailGet(mail_box_2, osWaitForever);
    if(evt.status == osEventMail)
		{			
			calc_mail_t* calc_mail = (calc_mail_t*) evt.value.p;
			
			char str1[24];
			sprintf(str1, "LDR = %3.2f", calc_mail->LDR_Percentage);
			BSP_LCD_DisplayStringAtLine(1, (uint8_t *)str1);
			
			char str2[24];
			sprintf(str2, "TDR = %.2f Deg C", calc_mail->TDR_Temperature);
			BSP_LCD_DisplayStringAtLine(2, (uint8_t *)str2);
			
			osMailFree(mail_box_2, calc_mail);
		}
  }
}
 
